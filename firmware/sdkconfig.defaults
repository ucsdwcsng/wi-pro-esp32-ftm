## firmware/sdkconfig.defaults
```kconfig
# Rust often needs a bit of an extra main task stack size compared to C (the default is 3K)
CONFIG_ESP_MAIN_TASK_STACK_SIZE=32768
# 64-packet FTM generates 2kb of timestamps in interrupt
CONFIG_ESP_SYSTEM_EVENT_TASK_STACK_SIZE=16384
# CONFIG_ESP_SYSTEM_CHECK_STACK_WATCHPOINT=y
# CONFIG_HEAP_POISONING_COMPREHENSIVE=y
# CONFIG_COMPILER_STACK_CHECK_MODE_STRONG=y
# CONFIG_FREERTOS_WATCHPOINT_END_OF_STACK=y

# Use this to set FreeRTOS kernel tick frequency to 1000 Hz (100 Hz by default).
# This allows to use 1 ms granularity for thread sleeps (10 ms by default).
#CONFIG_FREERTOS_HZ=1000

# Increase UART TX buffer
CONFIG_ESP_CONSOLE_UART_TX_BUF_SIZE=2048

# Or use USB-SERIAL-JTAG with larger buffer
CONFIG_ESP_CONSOLE_USB_SERIAL_JTAG_TX_BUF_SIZE=2048

# Workaround for https://github.com/espressif/esp-idf/issues/7631
#CONFIG_MBEDTLS_CERTIFICATE_BUNDLE=n
#CONFIG_MBEDTLS_CERTIFICATE_BUNDLE_DEFAULT_FULL=n

CONFIG_ESP_WIFI_FTM_ENABLE=y
CONFIG_ESP_WIFI_FTM_INITIATOR_SUPPORT=y
CONFIG_ESP_WIFI_FTM_RESPONDER_SUPPORT=y
CONFIG_ESP_WIFI_CSI_ENABLED=y
CONFIG_ESP32_WIFI_CSI_ENABLED=y

CONFIG_ESP_CONSOLE_USB_SERIAL_JTAG=y
CONFIG_ESP_CONSOLE_UART=n

CONFIG_PARTITION_TABLE_SINGLE_APP_LARGE=y
CONFIG_PARTITION_TABLE_TWO_OTA=n

CONFIG_GPTIMER_SKIP_LEGACY_CONFLICT_CHECK=y

CONFIG_DSP_OPTIMIZED=y

# Ensure esp_timer doesn't use Timer Group timers
# On ESP32-S3, esp_timer uses SYSTIMER by default, which is good
CONFIG_ESP_TIMER_IMPL_SYSTIMER=y

CONFIG_SPIRAM=y
CONFIG_SPIRAM_MODE_OCT=y
CONFIG_SPIRAM_SPEED_80M=y

# Disable legacy drivers to avoid conflicts
CONFIG_GPTIMER_SUPPRESS_DEPRECATE_WARN=n
CONFIG_RMT_SUPPRESS_DEPRECATE_WARN=n
CONFIG_PCNT_SUPPRESS_DEPRECATE_WARN=n
```
